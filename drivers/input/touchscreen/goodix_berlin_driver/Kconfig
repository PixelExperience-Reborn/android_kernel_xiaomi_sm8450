## drivers/input/touchscreen/goodix_berlin_driver/Kconfig
```kconfig
# SPDX-License-Identifier: GPL-2.0-only
config TOUCHSCREEN_GOODIX_BRL
	tristate "Goodix Berlin GT9916S SPI touchscreen (Xiaomi mondrian)"
	depends on SPI_MASTER && OF
	help
	  Berlin D touchscreen used by Xiaomi mondrian (M11A). The
	  SPI driver requires matching device firmware and configuration.
	  Compile as a module for the vendor's touch module load sequence.
```
